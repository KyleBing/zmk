## app/dts/bindings/behaviors/zmk,behavior-trackpad-mode.yaml
```yaml
# Copyright (c) 2026 KyleBing
# SPDX-License-Identifier: MIT

description: Trackpad mode control Behavior

compatible: "zmk,behavior-trackpad-mode"

include: one_param.yaml
```
